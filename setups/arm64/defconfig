## src/pass/Kconfig
```kconfig
menu "Compiler Passes"

config BEANDIP
  bool "BEANDIP"
  default n
  depends on !HALT_WHILE_IDLE
  help
    Enables the BEANDIP LLVM Pass

config CARAT_PASS
  bool "CARAT Pass"
  default n
  select CARAT_RT
  help
    Enables the CARAT LLVM Pass

config EXAMPLE_PASS
  bool "Example Pass"
  default n
  help
    Enables the Example LLVM Pass (does nothing)

endmenu
```

## src/test/Kconfig
```kconfig
menu "Tests"

config NPB_NAS_TEST
    bool "NPB NAS Tests"
    depends on !BASE_LIBM_COMPAT
    default n
    help
        Include the NAS Parallel Benchmark Test Suite

config NPB_NAS_BT
    bool "BT Benchmark"
    depends on NPB_NAS_TEST
    default n
    help
        Include the BT Benchmark from the NPB NAS benchmark suite.

config NPB_NAS_CG
    bool "CG Benchmark"
    depends on NPB_NAS_TEST
    default n
    help
        Include the CG Benchmark from the NPB NAS benchmark suite.

config NPB_NAS_EP
    bool "EP Benchmark"
    depends on NPB_NAS_TEST
    default n
    help
        Include the EP Benchmark from the NPB NAS benchmark suite.

config NPB_NAS_FT
    bool "FT Benchmark"
    depends on NPB_NAS_TEST
    default n
    help
        Include the FT Benchmark from the NPB NAS benchmark suite.

config NPB_NAS_IS
    bool "IS Benchmark"
    depends on NPB_NAS_TEST
    default n
    help
        Include the IS Benchmark from the NPB NAS benchmark suite.

config NPB_NAS_LU
    bool "LU Benchmark"
    depends on NPB_NAS_TEST
    default n
    help
        Include the LU Benchmark from the NPB NAS benchmark suite.

config NPB_NAS_MG
    bool "MG Benchmark"
    depends on NPB_NAS_TEST
    default n
    help
        Include the MG Benchmark from the NPB NAS benchmark suite.

config NPB_NAS_SP
    bool "SP Benchmark"
    depends on NPB_NAS_TEST
    default n
    help
        Include the SP Benchmark from the NPB NAS benchmark suite.

endmenu
```
